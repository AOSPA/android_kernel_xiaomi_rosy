## drivers/input/misc/fingerprint/Kconfig
```kconfig
source "drivers/input/misc/fingerprint/fpc/Kconfig"

source "drivers/input/misc/fingerprint/goodix/Kconfig"
```

## drivers/input/misc/fingerprint/fpc/Kconfig
```kconfig
config FPC1020_ROSY
	tristate "FPC1020 fingerprint driver"
	help
	  Say Y here to compile fingerprint drivers for FingerPrint Cards
	  FPC1020.

	  If unsure, say Y.
```

## drivers/input/misc/fingerprint/goodix/Kconfig
```kconfig
config GF3208_ROSY
	tristate "GF3208 fingerprint driver"
	help
	  Say Y here to compile fingerprint drivers for Goodix GF3208.

	  If unsure, say Y.
```

## drivers/input/touchscreen/FT8006m/Kconfig
```kconfig
config FT8006M_ROSY
	tristate "FT8006M touchscreen driver"
	help
	  Say Y here to compile touchscreen drivers for FocalTech FT8006M.

	  If unsure, say Y.
```
