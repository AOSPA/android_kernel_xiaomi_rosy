&int_codec {

	qcom,model = "msm8953-snd-card-mtp";
	qcom,msm-hs-micbias-type = "internal";
	status = "okay";

	/delete-property/ qcom,cdc-us-euro-gpios;
	/delete-property/ asoc-wsa-codec-names;
	/delete-property/ asoc-wsa-codec-prefixes;
	/delete-property/ msm-vdd-wsa-switch-supply;
	/delete-property/ qcom,msm-vdd-wsa-switch-voltage;
	/delete-property/ qcom,msm-vdd-wsa-switch-current;
	qcom,msm-mbhc-hphl-swh = <1>;
	qcom,msm-micbias2-ext-cap;
};

&pm8953_diangu_dig {
	status = "okay";
};

&pm8953_diangu_analog {
	status = "okay";
};
